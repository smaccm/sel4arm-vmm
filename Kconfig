## Kconfig
```kconfig
# This file defines the Kconfig menu structure.

mainmenu "Project Configuration"

config COMMON_PATH
    string
    option env="COMMON_PATH"

menu "seL4 Kernel"
source "kernel/Kconfig"
endmenu

menu "seL4 Applications"
    source "apps/linux/Kconfig"
    source "apps/sel4arm-vmm/Kconfig"
endmenu

menu "seL4 Libraries"
    source "libs/libsel4/Kconfig"
    source "libs/libmuslc/Kconfig"
    source "libs/libsel4muslcsys/Kconfig"
    source "libs/libsel4vka/Kconfig"
    source "libs/libsel4vspace/Kconfig"
    source "libs/libsel4allocman/Kconfig"
    source "libs/libsel4twinkle/Kconfig"
    source "libs/libcpio/Kconfig"
    source "libs/libelf/Kconfig"
    source "libs/libsel4utils/Kconfig"
    source "libs/libsel4platsupport/Kconfig"
    source "libs/libsel4test/Kconfig"
    source "libs/libsel4simple/Kconfig"
    source "libs/libsel4simple-default/Kconfig"
    source "libs/libsel4simple-stable/Kconfig"
    source "libs/libutils/Kconfig"
    source "libs/libplatsupport/Kconfig"
    source "libs/libsel4arm-vmm/Kconfig"
    source "tools/elfloader/Kconfig"
endmenu

source "$COMMON_PATH/Kconfig"
```

## apps/linux/Kconfig
```kconfig
#
# Copyright 2014, NICTA
#
# This software may be distributed and modified according to the terms of
# the BSD 2-Clause license. Note that NO WARRANTY is provided.
# See "LICENSE_BSD2.txt" for details.
#
# @TAG(NICTA_BSD)
#

menuconfig APP_LINUX
    bool "linux"
    default y
    select LINUX_PREBUILD
    help
        Linux Odroid-XU

config LINUX_PREBUILT
    bool "use prebuilt"
    depends on APP_LINUX
    default y
    help
        Use a pre-built image for linux
```

## apps/sel4arm-vmm/Kconfig
```kconfig
#
# Copyright 2014, NICTA
#
# This software may be distributed and modified according to the terms of
# the BSD 2-Clause license. Note that NO WARRANTY is provided.
# See "LICENSE_BSD2.txt" for details.
#
# @TAG(NICTA_BSD)
#

menuconfig APP_SEL4ARMVMM
    bool "seL4 ARM VMM"
    default y
    depends on HAVE_LIBC
    depends on LIB_SEL4_PLAT_SUPPORT
    depends on LIB_SEL4_VKA
    depends on LIB_SEL4_UTILS
    depends on LIB_UTILS
    depends on LIB_CPIO
    depends on LIB_SEL4
    depends on LIB_ELF
    depends on LIB_SEL4_ARM_VMM
    help
        ARM VMM that runs on the seL4 micro kernel
```
